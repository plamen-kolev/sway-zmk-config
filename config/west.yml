## config/west.yml
```yaml
manifest:
  remotes:
   
    - name: hallagat
      url-base: https://github.com/hallagat
    # Additional modules containing boards/shields/custom code can be listed here as well
    # See https://docs.zephyrproject.org/3.2.0/develop/west/manifest.html#projects
   
    - name: plamen-kolev
      url-base: https://github.com/plamen-kolev
   
    - name: petejohanson
      url-base: https://github.com/petejohanson
   
    - name: badjeff
      url-base: https://github.com/badjeff 
   
    - name: zmkfirmware
      url-base: https://github.com/zmkfirmware

  projects:
    - name: zmk
      remote: zmkfirmware
      revision: main
      import: app/west.yml

    - name: zmk-keyboard-sway
      remote: plamen-kolev
      revision: main

#   Haptic
    # - name: zmk-output-behavior-listener
    #   remote: badjeff
    #   revision: main
  
    # - name: zmk-drv2605-driver
    #   remote: badjeff
    #   revision: main
#   Endhaptic

    # - name: cirque-input-module
    #   revision: main
    #   remote: petejohanson
    # - name: nice-view-gem #new entry
    #   remote: m165437 #new entry
    #   revision: main #new entry
  self:
    path: config
```
